## dts/bindings/greybus/zephyr,greybus-device.yaml
```yaml
# SPDX-License-Identifier: BSD-3-Clause

description: Greybus Device

compatible: "zephyr,greybus-device"

include: [base.yaml]

properties:
    "driver-string-id":
      type: phandle
      required: true
      description: "Reference to greybus-string describing the device driver"
    "id":
      type: int
      required: true
    "protocol":
      type: int
      required: true
    "addr":
      type: int
      required: true
    "irq":
      type: int
    "irqtype":
      type: int
    "max-speed-hz":
      type: int
    "mode":
      type: int
    "prop-link":
      type: int
    "gpio-link":
      type: int
    "clock-link":
      type: int
    "reg-link":
      type: int
```

## dts/bindings/greybus/zephyr,greybus-mikrobus.yaml
```yaml
# SPDX-License-Identifier: BSD-3-Clause

description: Greybus mikroBUS state descriptor

compatible: "zephyr,greybus-mikrobus"

include: ["base.yaml"]

properties:
    "pwmstate":
      type: int
      required: true
    "intstate":
      type: int
      required: true
    "rxstate":
      type: int
      required: true
    "txstate":
      type: int
      required: true
    "sclstate":
      type: int
      required: true
    "sdastate":
      type: int
      required: true
    "mosistate":
      type: int
      required: true
    "misostate":
      type: int
      required: true
    "sckstate":
      type: int
      required: true
    "csstate":
      type: int
      required: true
    "rststate":
      type: int
      required: true
    "anstate":
      type: int
      required: true
```

## dts/bindings/greybus/zephyr,greybus-mikrobusid.yaml
```yaml
# Copyright (c) 2021  BeagleBoard.org Foundation
# SPDX-License-Identifier: Apache-2.0

description: mikroBUS Click ID support

compatible: "zephyr,greybus-mikrobusid"

include: [base.yaml]

properties:
    "id":
      type: int
      required: true
      description: mikroBUS ID
    cs-gpios:
      type: phandle-array
      required: true
      description: mikrobus CS GPIO
    sclk-gpios:
      type: phandle-array
      required: true
      description: mikrobus SCLK GPIO
    mosi-gpios:
      type: phandle-array
      required: true
      description: mikrobus MOSI GPIO
```

## dts/bindings/greybus/zephyr,greybus-property.yaml
```yaml
# SPDX-License-Identifier: BSD-3-Clause

description: Greybus Property

compatible: "zephyr,greybus-property"

include: [base.yaml]

properties:
    "name-string-id":
      type: phandle
      required: true
      description: "Reference to greybus-string describing the device driver"
    "id":
      type: int
      required: true
    "type":
      type: int
      required: true
    "value":
      type: array
      required: true
```

## dts/bindings/greybus/zephyr,greybus-pwm-control.yaml
```yaml
# Copyright (c) 2022, Harshil Bhatt
# SPDX-License-Identifier: BSD-3-Clause

# Common fields for Greybus PWM Controllers

description: Greybus PWM Controller

compatible: "zephyr,greybus-pwm-controller"

include: ["zephyr,greybus-cport.yaml"]

properties:
    "greybus-pwm-controller":
      type: phandle
      required: true
      description: Conveys which PWM port is associated with this Greybus PWM Controller instance
    "cport-protocol":
      type: int
      # PWM protocol
      default: 0x09
      const: 0x09
      description: The PWM CPort protocol
```

## dts/bindings/greybus/zephyr,greybus-uart-control.yaml
```yaml
# Copyright (c) 2022, Harshil Bhatt
# SPDX-License-Identifier: BSD-3-Clause

# Common fields for Greybus UART Controllers

description: Greybus UART Controller

compatible: "zephyr,greybus-uart-controller"

include: ["zephyr,greybus-cport.yaml"]

properties:
    "greybus-uart-controller":
      type: phandle
      required: true
      description: Conveys which UART port is associated with this Greybus UART Controller instance
    "cport-protocol":
      type: int
      # UART protocol
      default: 0x04
      const: 0x04
      description: The UART CPort protocol
```

## samples/subsys/greybus/net/boards/beagleconnect_freedom.conf
```kconfig
CONFIG_GPIO=y
CONFIG_GREYBUS_GPIO=y

CONFIG_SPI=y
CONFIG_GREYBUS_SPI=y

CONFIG_I2C=y
CONFIG_GREYBUS_I2C=y

CONFIG_SERIAL=y
CONFIG_UART_LINE_CTRL=y
CONFIG_GREYBUS_UART=y

CONFIG_OPT3001=n
CONFIG_LIS2DH=n
CONFIG_LIS2DH_OPER_MODE_LOW_POWER=n
CONFIG_TI_HDC20XX=n
#CONFIG_GREYBUS_CLICK_MANIFEST_CLICKID=y
#CONFIG_GREYBUS_CLICK_MANIFEST_BUILTIN=y
#CONFIG_GREYBUS_MIKROBUS_CLICK1_NAME="RTC-6-CLICK"
#CONFIG_GREYBUS_MIKROBUS_CLICK2_NAME="WEATHER-CLICK"
```

## samples/subsys/greybus/net/boards/cc1352r1_launchxl.conf
```kconfig
CONFIG_GPIO=y
CONFIG_GREYBUS_GPIO=y

CONFIG_SPI=y
CONFIG_SPI_0=y
CONFIG_GREYBUS_SPI=y

CONFIG_I2C=y
CONFIG_GREYBUS_I2C=y

#CONFIG_GREYBUS_CLICK_MANIFEST_BUILTIN=n
CONFIG_GREYBUS_CLICK_MANIFEST_CLICKID=y
CONFIG_CC13X2_CC26X2_BOOTLOADER_BACKDOOR_ENABLE=n
#CONFIG_GREYBUS_MIKROBUS_CLICK1_NAME="WEATHER-CLICK"
#CONFIG_GREYBUS_MIKROBUS_CLICK2_NAME="AIR-QUALITY-2-CLICK"
```

## samples/subsys/greybus/net/boards/cc1352r_sensortag.conf
```kconfig
CONFIG_GPIO=y
CONFIG_GREYBUS_GPIO=y

CONFIG_I2C=y
CONFIG_GREYBUS_I2C=y

CONFIG_SPI=y
CONFIG_SPI_0=y
CONFIG_GREYBUS_SPI=y

# useful for verifying functionality with SPI
CONFIG_SENSOR=y
CONFIG_ADXL362=y
CONFIG_SENSOR_SHELL=y
CONFIG_GREYBUS_LOG_LEVEL_DBG=n
CONFIG_GREYBUS_CLICK_MANIFEST_BUILTIN=y
CONFIG_GREYBUS_MIKROBUS_CLICK1_NAME="WEATHER-CLICK"
CONFIG_GREYBUS_MIKROBUS_CLICK2_NAME="AIR-QUALITY-2-CLICK"
```
